## components/network/Kconfig.projbuild
```kconfig
menu "Ouchat Configuration"

    config OUCHAT_KEY
        string "Ouchat Secret Key"
        default "mykey"
        help
            The secret key of your ouchat.

    config OUCHAT_CAT
        string "Ouchat Cat ID"
        default "mycat"
        help
            The ID of your cat.

    config OUCHAT_DEBUG_LOGGER
        bool "Ouchat Logger"
        help
            Used to debug Ouchat

    menu "Debug Logger"
        depends on OUCHAT_DEBUG_LOGGER

        config OUCHAT_DEBUG_LOGGER_IP
            string "Logger Server IP"
            default "0.0.0.0"
            help
                The IP of the logging server

        config OUCHAT_DEBUG_CAM
            bool "Camera for ai training"

        config OUCHAT_DEBUG_CAM_SDA
            int "Camera sda pin"
            default 7
            range 0 34
            depends on OUCHAT_DEBUG_CAM
            help
                The pin used to communicate to the camera

        config OUCHAT_DEBUG_CAM_SCL
            int "Camera sda pin"
            default 6
            range 0 34
            depends on OUCHAT_DEBUG_CAM
            help
                The pin used to communicate to the camera

    endmenu
endmenu
```

## components/ouchat/Kconfig.projbuild
```kconfig
menu "Ouchat Configuration"

    config OUCHAT_KEY
        string "Ouchat Secret Key"
        default "mykey"
        help
            The secret key of your ouchat.

    config OUCHAT_CAT
        string "Ouchat Cat ID"
        default "mycat"
        help
            The ID of your cat.

    config OUCHAT_DEBUG_LOGGER
        bool "Ouchat Logger"
        help
            Used to debug Ouchat

    menu "Debug Logger"
        depends on OUCHAT_DEBUG_LOGGER

        config OUCHAT_DEBUG_LOGGER_IP
            string "Logger Server IP"
            default "0.0.0.0"
            help
                The IP of the logging server

    endmenu
endmenu
```

## main/Kconfig.projbuild
```kconfig
menu "Ouchat Configuration"

    config I2C_MASTER_SCL
        int "SCL GPIO Num"
        default 6 if IDF_TARGET_ESP32C3 || IDF_TARGET_ESP32C2 || IDF_TARGET_ESP32H2
        default 19 if IDF_TARGET_ESP32 || IDF_TARGET_ESP32S2 || IDF_TARGET_ESP32S3
        help
            GPIO number for I2C Master clock line.

    config I2C_MASTER_SDA
        int "SDA GPIO Num"
        default 5 if IDF_TARGET_ESP32C3 || IDF_TARGET_ESP32C2 || IDF_TARGET_ESP32H2
        default 18 if IDF_TARGET_ESP32 || IDF_TARGET_ESP32S2 || IDF_TARGET_ESP32S3
        help
            GPIO number for I2C Master data line.

config ESP_WIFI_SSID
        string "WiFi SSID"
        default "myssid"
        help
            SSID (network name) for the example to connect to.

    config ESP_WIFI_PASSWORD
        string "WiFi Password"
        default "mypassword"
        help
            WiFi password (WPA or WPA2) for the example to use.

    config ESP_MAXIMUM_RETRY
        int "Maximum retry"
        default 5
        help
            Set the Maximum retry to avoid station reconnecting to the AP unlimited when the AP is really inexistent.


endmenu
```
